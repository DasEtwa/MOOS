## configs/moos_native_installer_x86_64_defconfig
```kconfig
BR2_x86_64=y
BR2_REPRODUCIBLE=y
BR2_GLOBAL_PATCH_DIR="../patches board/qemu/patches"
BR2_DOWNLOAD_FORCE_CHECK_HASHES=y
BR2_TOOLCHAIN_EXTERNAL=y
BR2_TOOLCHAIN_EXTERNAL_CUSTOM=y
BR2_TOOLCHAIN_EXTERNAL_PATH="../output/native/host"
BR2_TOOLCHAIN_EXTERNAL_CUSTOM_PREFIX="x86_64-buildroot-linux-gnu"
BR2_TOOLCHAIN_EXTERNAL_GCC_14=y
BR2_TOOLCHAIN_EXTERNAL_HEADERS_6_18=y
BR2_TOOLCHAIN_EXTERNAL_CUSTOM_GLIBC=y
BR2_TOOLCHAIN_EXTERNAL_HAS_SSP=y
# BR2_TOOLCHAIN_EXTERNAL_INET_RPC is not set
BR2_TARGET_GENERIC_HOSTNAME="moos-installer"
BR2_TARGET_GENERIC_ISSUE="MOOS Native Installer (experimental)"
# BR2_TARGET_ENABLE_ROOT_LOGIN is not set
# BR2_TARGET_GENERIC_GETTY is not set
BR2_ROOTFS_OVERLAY="../system/native-installer/overlay"
BR2_ROOTFS_POST_BUILD_SCRIPT="../scripts/native-installer-post-build.sh"
BR2_ROOTFS_POST_IMAGE_SCRIPT="../scripts/native-installer-post-image.sh"
BR2_PACKAGE_BUSYBOX_CONFIG_FRAGMENT_FILES="../system/native/busybox.fragment"
BR2_LINUX_KERNEL=y
BR2_LINUX_KERNEL_CUSTOM_VERSION=y
BR2_LINUX_KERNEL_CUSTOM_VERSION_VALUE="6.18.43"
BR2_LINUX_KERNEL_USE_CUSTOM_CONFIG=y
BR2_LINUX_KERNEL_CUSTOM_CONFIG_FILE="../system/native-installer/linux.config"
BR2_LINUX_KERNEL_NEEDS_HOST_LIBELF=y
BR2_TARGET_ROOTFS_CPIO=y
BR2_TARGET_ROOTFS_CPIO_GZIP=y
# BR2_TARGET_ROOTFS_TAR is not set
BR2_TARGET_GRUB2=y
BR2_TARGET_GRUB2_I386_PC=y
BR2_TARGET_GRUB2_X86_64_EFI=y
BR2_TARGET_GRUB2_BOOT_PARTITION=",gpt2"
BR2_TARGET_GRUB2_BUILTIN_MODULES_PC="boot linux fat part_gpt normal biosdisk serial terminal search search_fs_uuid echo gzio"
BR2_TARGET_GRUB2_BUILTIN_MODULES_EFI="boot linux fat part_gpt normal serial terminal search search_fs_uuid echo gzio"
BR2_TARGET_GRUB2_INSTALL_TOOLS=y
BR2_PACKAGE_UTIL_LINUX=y
BR2_PACKAGE_UTIL_LINUX_BINARIES=y
BR2_PACKAGE_E2FSPROGS=y
# BR2_PACKAGE_E2FSPROGS_FSCK is not set
# BR2_PACKAGE_E2FSPROGS_RESIZE2FS is not set
BR2_PACKAGE_HOST_DOSFSTOOLS=y
BR2_PACKAGE_HOST_GENIMAGE=y
BR2_PACKAGE_HOST_MTOOLS=y

BR2_PACKAGE_MTOOLS=y
```

## configs/moos_native_x86_64_defconfig
```kconfig
BR2_x86_64=y
BR2_REPRODUCIBLE=y
BR2_PACKAGE_HOST_LINUX_HEADERS_CUSTOM_6_18=y
BR2_GLOBAL_PATCH_DIR="../patches board/qemu/patches"
BR2_DOWNLOAD_FORCE_CHECK_HASHES=y
BR2_TARGET_GENERIC_HOSTNAME="moos-native"
BR2_TARGET_GENERIC_ISSUE="MOOS Native"
# BR2_TARGET_ENABLE_ROOT_LOGIN is not set
BR2_TARGET_GENERIC_GETTY_PORT="ttyS0"
BR2_TARGET_GENERIC_GETTY_BAUDRATE_115200=y
BR2_SYSTEM_DHCP="eth0"
BR2_ROOTFS_OVERLAY="../system/overlay ../system/native/overlay"
BR2_ROOTFS_POST_BUILD_SCRIPT="../scripts/native-post-build.sh"
BR2_ROOTFS_POST_IMAGE_SCRIPT="../scripts/native-post-image.sh"
BR2_PACKAGE_BUSYBOX_CONFIG_FRAGMENT_FILES="../system/native/busybox.fragment"
BR2_LINUX_KERNEL=y
BR2_LINUX_KERNEL_CUSTOM_VERSION=y
BR2_LINUX_KERNEL_CUSTOM_VERSION_VALUE="6.18.43"
BR2_LINUX_KERNEL_USE_CUSTOM_CONFIG=y
BR2_LINUX_KERNEL_CUSTOM_CONFIG_FILE="../system/native/linux.config"
BR2_LINUX_KERNEL_NEEDS_HOST_LIBELF=y
BR2_TARGET_ROOTFS_EXT2=y
BR2_TARGET_ROOTFS_EXT2_4=y
BR2_TARGET_ROOTFS_EXT2_LABEL="MOOS_SYSTEM_A"
BR2_TARGET_ROOTFS_EXT2_MKFS_OPTIONS="-O ^64bit -U 4d4f4f53-0000-4000-8000-000000000001 -E hash_seed=4d4f4f53-0000-4000-8000-000000000002,lazy_itable_init=0,lazy_journal_init=0"
# BR2_TARGET_ROOTFS_TAR is not set
BR2_TARGET_GRUB2=y
BR2_TARGET_GRUB2_I386_PC=y
BR2_TARGET_GRUB2_X86_64_EFI=y
BR2_TARGET_GRUB2_BOOT_PARTITION=",gpt2"
BR2_TARGET_GRUB2_BUILTIN_MODULES_PC="boot linux fat part_gpt normal biosdisk serial terminal search search_fs_uuid search_fs_file echo"
BR2_TARGET_GRUB2_BUILTIN_MODULES_EFI="boot linux fat part_gpt normal serial terminal search search_fs_uuid search_fs_file echo"
BR2_PACKAGE_HOST_DOSFSTOOLS=y
BR2_PACKAGE_HOST_GENIMAGE=y
BR2_PACKAGE_HOST_MTOOLS=y
```
